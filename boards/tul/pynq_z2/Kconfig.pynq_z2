## boards/tul/pynq_z2/Kconfig.pynq_z2
```kconfig
# TUL PYNQ-Z2 board configuration

# Copyright (c) 2026 Radu Pirea
# SPDX-License-Identifier: Apache-2.0

config BOARD_PYNQ_Z2
	select SOC_XC7Z020
```

## boards/tul/pynq_z2/board.yml
```yaml
board:
  name: pynq_z2
  full_name: PYNQ-Z2
  vendor: tul
  socs:
  - name: xc7z020
```

## drivers/cache/Kconfig.pl310
```kconfig
# Copyright (c) 2026 Radu Pirea
# SPDX-License-Identifier: Apache-2.0

config CACHE_PL310
	bool "ARM L2C-310 level two cache controller driver"
	default y
	depends on DT_HAS_ARM_PL310_CACHE_ENABLED
	depends on EXTERNAL_CACHE
	depends on CPU_AARCH32_CORTEX_A
	select CACHE_HAS_DRIVER
	help
	  Enable the driver for the ARM CoreLink Level 2 Cache Controller
	  (L2C-310, formerly PL310). The driver performs the maintenance of the
	  level one caches of the processor as well, since the level two cache
	  is only reachable through them.
```

## drivers/clock_control/Kconfig.xlnx_ps7
```kconfig
# Copyright (c) 2026 Radu Pirea
# SPDX-License-Identifier: Apache-2.0

config CLOCK_CONTROL_XLNX_PS7
	bool "Xilinx Zynq-7000 PS clock controller driver"
	default y
	depends on DT_HAS_XLNX_PS7_CLKC_ENABLED
	depends on SYSCON
	help
	  Enable the clock controller driver for the PS clock subsystem of the
	  Xilinx Zynq-7000, which derives every clock of the processing system
	  from the PS reference clock.

if CLOCK_CONTROL_XLNX_PS7

config CLOCK_CONTROL_XLNX_PS7_INIT_PRIORITY
	int "Xilinx Zynq-7000 PS clock controller init priority"
	default 55
	help
	  Initialization priority of the clock controller. It reaches the clock
	  registers through the system level control registers, so it has to be
	  initialized after them, which means a value above SYSCON_INIT_PRIORITY.

endif # CLOCK_CONTROL_XLNX_PS7
```

## drivers/reset/Kconfig.xlnx_zynq
```kconfig
# Copyright (c) 2026 Radu Pirea
# SPDX-License-Identifier: Apache-2.0

config RESET_XLNX_ZYNQ
	bool "Xilinx Zynq-7000 reset controller driver"
	default y
	depends on DT_HAS_XLNX_ZYNQ_RESET_ENABLED
	depends on SYSCON
	help
	  Enable the reset controller driver for the Xilinx Zynq-7000, which
	  drives the reset control registers of the processing system.

if RESET_XLNX_ZYNQ

config RESET_XLNX_ZYNQ_INIT_PRIORITY
	int "Xilinx Zynq-7000 reset controller init priority"
	default 15
	help
	  Initialization priority of the reset controller. It reaches the reset
	  registers through the system level control registers, so it has to be
	  initialized after them, which means a value above SYSCON_INIT_PRIORITY.

endif # RESET_XLNX_ZYNQ
```

## drivers/spi/Kconfig.xlnx_zynq_qspi
```kconfig
# Copyright (c) 2026 Radu Pirea
# SPDX-License-Identifier: Apache-2.0

config SPI_XLNX_ZYNQ_QSPI
	bool "Xilinx Zynq-7000 QSPI driver"
	default y
	depends on DT_HAS_XLNX_ZYNQ_QSPI_1_0_ENABLED
	help
	  Enable the Xilinx Zynq-7000 Quad SPI (QSPI) controller driver. The
	  controller is operated as an ordinary single line SPI controller,
	  which is normally used with the QSPI flash device a Zynq-7000 board
	  boots from, but can also be used with other SPI devices. The quad and
	  dual width commands of a flash device are not available this way.
```

## drivers/watchdog/Kconfig.cdns
```kconfig
# Copyright (c) 2026 Radu Pirea
# SPDX-License-Identifier: Apache-2.0

config WDT_CDNS
	bool "Cadence WDT r1p2 watchdog driver"
	default y
	depends on DT_HAS_CDNS_WDT_R1P2_ENABLED
	select HAS_WDT_DISABLE_AT_BOOT
	help
	  Enable the Cadence WDT r1p2 watchdog driver, which drives the system
	  watchdog timer (SWDT) of the Xilinx Zynq-7000.
```

## dts/bindings/cache/arm,pl310-cache.yaml
```yaml
# Copyright (c) 2026 Radu Pirea
# SPDX-License-Identifier: Apache-2.0

description: |
  ARM CoreLink Level 2 Cache Controller (L2C-310, formerly PL310).

  The controller backs the level one caches of the Cortex-A processor it sits
  below, so the driver performs the maintenance of both levels in the order
  each operation needs. It addresses its lines physically and is therefore only
  usable where the mapping it is reached through is flat.

compatible: "arm,pl310-cache"

include: base.yaml

properties:
  reg:
    required: true
```

## dts/bindings/clock/xlnx,ps7-clkc.yaml
```yaml
# Copyright (c) 2026 Radu Pirea
# SPDX-License-Identifier: Apache-2.0

description: |
  Xilinx Zynq-7000 PS clock subsystem.

  The controller derives every clock of the processing system from the PS
  reference clock through the three PLLs and the divider of each peripheral,
  all of which live in the system level control registers. Consumers name a
  clock by one of the identifiers in
  <zephyr/dt-bindings/clock/xlnx-ps7-clkc.h>.

compatible: "xlnx,ps7-clkc"

include: [clock-controller.yaml, base.yaml]

properties:
  reg:
    required: true

  syscon:
    type: phandle
    required: true
    description: The system level control registers holding the clock registers.

  ps-clk-frequency:
    type: int
    required: true
    description: |
      Frequency in Hz of the PS reference clock the board feeds the PS_CLK
      pin, from which every PLL output is derived.

  "#clock-cells":
    const: 1

clock-cells:
  - id
```

## dts/bindings/reset/xlnx,zynq-reset.yaml
```yaml
# Copyright (c) 2026 Radu Pirea
# SPDX-License-Identifier: Apache-2.0

description: |
  Xilinx Zynq-7000 reset controller.

  The reset control registers of the processing system live in the system
  level control registers, one register per group of peripherals. A consumer
  names a reset by one of the identifiers in
  <zephyr/dt-bindings/reset/xlnx-zynq-reset.h>, which encode the register and
  the bit within it.

compatible: "xlnx,zynq-reset"

include: [reset-controller.yaml, base.yaml]

properties:
  reg:
    required: true

  syscon:
    type: phandle
    required: true
    description: The system level control registers holding the reset registers.

  "#reset-cells":
    const: 1

reset-cells:
  - id
```

## dts/bindings/serial/xlnx,xuartps.yaml
```yaml
description: Xilinx PS UART

compatible: "xlnx,xuartps"

include: [uart-controller.yaml, pinctrl-device.yaml]

properties:
  reg:
    required: true

  clocks:
    description: |
      The UART reference clock. A platform without a clock controller gives
      its frequency as clock-frequency instead.
```

## dts/bindings/spi/xlnx,zynq-qspi-1.0.yaml
```yaml
# Copyright (c) 2026 Radu Pirea
# SPDX-License-Identifier: Apache-2.0

description: |
  Xilinx Zynq-7000 Quad SPI (QSPI) controller.

  The driver operates the controller in I/O mode with the flash memory
  interface turned off, that is, as an ordinary single line SPI controller.
  Only SPI modes 0 and 3 are reachable, as the controller ties the clock phase
  to the clock polarity. The linear address (LQSPI) mode a boot loader may have
  left the controller in is turned off during initialization. The dual parallel
  and dual stacked memory configurations are not supported, so at most two chip
  selects, driven one at a time, are available.

compatible: "xlnx,zynq-qspi-1.0"

include: [spi-controller.yaml]

properties:
  reg:
    required: true

  interrupts:
    description: |
      The controller's interrupt line. The driver drives the controller by
      polling and leaves the interrupt masked, so the property is only there to
      describe the hardware.

  clock-frequency:
    required: true
    description: |
      Frequency in Hz of the QSPI reference clock (QSPI_CLK) feeding the
      controller. The SCLK frequency requested by a device on the bus is
      derived from it by a power-of-two divider between 2 and 256, rounded
      down to the closest frequency that does not exceed the request.
```

## dts/bindings/watchdog/cdns,wdt-r1p2.yaml
```yaml
# Copyright (c) 2026 Radu Pirea
# SPDX-License-Identifier: Apache-2.0

description: |
  Cadence WDT r1p2 watchdog timer, the system watchdog timer (SWDT) of the
  Xilinx Zynq-7000.

  The watchdog has a single timeout, counted down by a 24 bit counter whose
  reload value has its low 12 bits fixed to ones, fed through a prescaler
  dividing the input clock by 8, 64, 512 or 4096. A requested timeout is
  therefore rounded up to what the pair can express.

compatible: "cdns,wdt-r1p2"

include: [base.yaml, reset-device.yaml]

properties:
  reg:
    required: true

  interrupts:
    required: true
    description: |
      The watchdog's interrupt line, raised on expiry while the interrupt
      output is enabled, which the driver only does for a timeout that
      installs a callback.

  clock-frequency:
    type: int
    required: true
    description: |
      Frequency in Hz of the clock feeding the watchdog's prescaler. This is
      the CPU_1x clock unless the SLCR selects an external or PL clock, which
      this driver does not do.
```
